#include <SPI.h>
#include <Wire.h>
#include <Adafruit_GFX.h>
#include <Adafruit_SSD1306.h>
#include <Adafruit_AHTX0.h>
#include <ESP8266WiFi.h>
#include "Adafruit_MQTT.h"
#include "Adafruit_MQTT_Client.h"
#include <WiFiManager.h>

WiFiManager wifiManager;
// 'logo', 128x64px
const unsigned char logologo [] PROGMEM = {
  0x00, 0x00, 0x00, 0x00, 0x00, 0x00, 0x00, 0x00, 0x00, 0x00, 0x00, 0x00, 0x00, 0x00, 0x00, 0x00, 
  0x00, 0x00, 0x00, 0x00, 0x00, 0x00, 0x00, 0x00, 0x00, 0x00, 0x00, 0x00, 0x00, 0x00, 0x00, 0x00, 
  0x00, 0x00, 0x00, 0x00, 0x00, 0x00, 0x00, 0x00, 0x00, 0x00, 0x00, 0x00, 0x00, 0x00, 0x00, 0x00, 
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  0x03, 0xff, 0xfb, 0xff, 0xff, 0xff, 0xfc, 0x00, 0x00, 0x00, 0x00, 0x00, 0x00, 0x00, 0x00, 0x00
};

// Array of all bitmaps for convenience. (Total bytes used to store images in PROGMEM = 1040)
const int logoallArray_LEN = 1;
const unsigned char* logoallArray[1] = {
  logologo
};
// 'tempHot', 20x20px
const unsigned char tempHot [] PROGMEM = {
  0x01, 0xf8, 0x00, 0x07, 0xff, 0x00, 0x1f, 0xff, 0x80, 0x3f, 0xff, 0xc0, 0x3f, 0xbf, 0xe0, 0x7f, 
  0x9f, 0xe0, 0x7f, 0x0f, 0xf0, 0xff, 0x03, 0xf0, 0xfc, 0x01, 0xf0, 0xf8, 0x01, 0xf0, 0xf8, 0x30, 
  0xf0, 0xf8, 0xf0, 0xf0, 0xf9, 0xf8, 0xf0, 0x79, 0xf9, 0xf0, 0x7d, 0xf9, 0xe0, 0x3f, 0xfb, 0xe0, 
  0x3f, 0xff, 0xc0, 0x1f, 0xff, 0x80, 0x0f, 0xff, 0x00, 0x01, 0xfc, 0x00
};

// 'tempOri', 20x20px
const unsigned char tempOri [] PROGMEM = {
  0x00, 0x00, 0x00, 0x00, 0x00, 0x00, 0x00, 0x00, 0x00, 0x00, 0x00, 0x00, 0x00, 0x60, 0x00, 0x00, 
  0x90, 0x00, 0x01, 0x08, 0x00, 0x01, 0x08, 0x00, 0x01, 0x68, 0x00, 0x01, 0x68, 0x00, 0x01, 0x68, 
  0x00, 0x01, 0x68, 0x00, 0x02, 0xe8, 0x00, 0x02, 0xf4, 0x00, 0x02, 0xf4, 0x00, 0x02, 0xf4, 0x00, 
  0x03, 0x68, 0x00, 0x01, 0x98, 0x00, 0x00, 0x00, 0x00, 0x00, 0x00, 0x00
};

// 'tempCold', 20x20px
const unsigned char tempCold [] PROGMEM = {
  0x01, 0xf0, 0x00, 0x07, 0xfe, 0x00, 0x0f, 0xff, 0x00, 0x1f, 0xff, 0x80, 0x3f, 0x8f, 0xc0, 0x3f, 
  0x0f, 0xc0, 0x79, 0x99, 0xe0, 0x78, 0x91, 0xe0, 0x78, 0x00, 0xe0, 0xff, 0x0f, 0xe0, 0xff, 0x0f, 
  0xe0, 0x78, 0x00, 0xe0, 0x78, 0x91, 0xe0, 0x79, 0x99, 0xe0, 0x3f, 0x0f, 0xc0, 0x3f, 0x8f, 0xc0, 
  0x1f, 0xff, 0x80, 0x0f, 0xff, 0x00, 0x07, 0xfc, 0x00, 0x00, 0xf0, 0x00
};

// 'humid', 20x20px
const unsigned char humidIcon [] PROGMEM = {
  0xff, 0xfc, 0xf0, 0xff, 0xf8, 0x70, 0xff, 0xf0, 0x30, 0xff, 0x30, 0x30, 0xfe, 0x00, 0x10, 0xfc, 
  0x06, 0x00, 0xcc, 0x07, 0x00, 0x80, 0xc7, 0x00, 0x81, 0xe3, 0xc0, 0x01, 0xe1, 0x80, 0x11, 0xf1, 
  0x00, 0x31, 0xf8, 0x10, 0x01, 0xe0, 0x30, 0x03, 0xf0, 0xf0, 0x87, 0xe0, 0xf0, 0xe3, 0xc0, 0xf0, 
  0xe3, 0x11, 0xf0, 0xf0, 0x01, 0xf0, 0xf8, 0x07, 0xf0, 0xfc, 0x0f, 0xf0
};
/************************* Adafruit.io Setup *********************************/

#define AIO_SERVER      "io.adafruit.com"
// Using port 8883 for MQTTS
#define AIO_SERVERPORT  1883
// Adafruit IO Account Configuration
// (to obtain these values, visit https://io.adafruit.com and click on Active Key)
#define AIO_USERNAME    "DogeEngizear"
#define AIO_KEY         "aio_HggL41SKNqLHXZVtTcPcSGiHrRL1"

 
/************ Global State (you don't need to change this!) ******************/

// WiFiFlientSecure for SSL/TLS support
WiFiClient client;

// Setup the MQTT client class by passing in the WiFi client and MQTT server and login details.
Adafruit_MQTT_Client mqtt(&client, AIO_SERVER, AIO_SERVERPORT, AIO_USERNAME, AIO_KEY);


/****************************** Feeds ***************************************/

// Notice MQTT paths for AIO follow the form: <username>/feeds/<feedname>
Adafruit_MQTT_Publish tempfeed = Adafruit_MQTT_Publish(&mqtt, AIO_USERNAME "/feeds/temp-feed");
Adafruit_MQTT_Publish humidfeed = Adafruit_MQTT_Publish(&mqtt, AIO_USERNAME "/feeds/humid-feed");

/***************************************************************************/
#define SCREEN_WIDTH 128 // OLED display width, in pixels
#define SCREEN_HEIGHT 64 // OLED display height, in pixels

// Declaration for an SSD1306 display connected to I2C (SDA, SCL pins)
// The pins for I2C are defined by the Wire-library. 
// On an arduino UNO:       A4(SDA), A5(SCL)
// On an arduino MEGA 2560: 20(SDA), 21(SCL)
// On an arduino LEONARDO:   2(SDA),  3(SCL), ...
#define OLED_RESET     -1 // Reset pin # (or -1 if sharing Arduino reset pin)
#define SCREEN_ADDRESS 0x3C ///< See datasheet for Address; 0x3D for 128x64, 0x3C for 128x32
Adafruit_SSD1306 display(SCREEN_WIDTH, SCREEN_HEIGHT, &Wire, OLED_RESET);
Adafruit_AHTX0 aht;
float temp1;
float humid1;
void MQTT_connect();

void setup() {
  Serial.begin(9600);
  delay(10);
  wifiManager.autoConnect("DOGEENZINEAR");
  delay(1000);
  if(!display.begin(SSD1306_SWITCHCAPVCC, SCREEN_ADDRESS)) {
    Serial.println(F("SSD1306 allocation failed"));
    for(;;); // Don't proceed, loop forever
  }

  // Show initial display buffer contents on the screen --
  // the library initializes this with an Adafruit splash screen.
  display.clearDisplay();
  delay(1000);
  display.drawBitmap(0, 0, logologo, 128, 64, WHITE);
  display.display();
  delay(3000); // Pause for 3 seconds


  display.clearDisplay();
  delay(1000);
  if (aht.begin()) {
    Serial.println("Found AHT10");
  } else {
    Serial.println("Didn't find AHT10");
  } 
}

void loop() {
  MQTT_connect();
  sensors_event_t humidity, temp;
  
  aht.getEvent(&humidity, &temp);// populate temp and humidity objects with fresh data
  temp1 = temp.temperature;
  humid1 = humidity.relative_humidity;
 
  tempfeed.publish(temp1);
  humidfeed.publish(humid1);
  
  display.setCursor(0,0);
  display.setTextSize(2);
  display.setTextColor(WHITE); 
  display.print("Temp&Humid");
  if (temp1 >=26)
  {
    display.drawBitmap(0, 20, tempHot, 20, 20, WHITE);
    display.setCursor(25,20);display.print(temp1);display.print(" C");
  }
  else if(temp1 >=20)
  {
    display.drawBitmap(0, 20, tempOri, 20, 20, WHITE);
    display.setCursor(25,20);display.print(temp1);display.print(" C");
  }
  else
  {
    display.drawBitmap(0, 20, tempCold, 20, 20, WHITE);
    display.setCursor(25,20);display.print(temp1);display.print(" C");
  }
  display.setCursor(0,50);
  display.drawBitmap(0, 45,humidIcon, 20, 20, WHITE); 
  display.setCursor(25,50);display.print(humid1);display.print(" %");
  Serial.print("Temperature: ");Serial.print(temp1);Serial.println(" degrees C");
  Serial.print("Humidity: ");Serial.print(humid1);Serial.println(" RH %");
  
  display.display();
  delay(5000);
}
void MQTT_connect() {
  int8_t ret;

  // Stop if already connected.
  if (mqtt.connected()) {
    return;
  }

  Serial.print("Connecting to MQTT... ");

  uint8_t retries = 3;
  while ((ret = mqtt.connect()) != 0) { // connect will return 0 for connected
       Serial.println(mqtt.connectErrorString(ret));
       Serial.println("Retrying MQTT connection in 5 seconds...");
       mqtt.disconnect();
       delay(5000);  // wait 5 seconds
       retries--;
       if (retries == 0) {
         // basically die and wait for WDT to reset me
         while (1);
       }
  }

  Serial.println("MQTT Connected!");
}
